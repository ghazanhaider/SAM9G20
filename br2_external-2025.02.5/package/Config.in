## br2_external-2025.02.5/package/tinycc/Config.in
```kconfig
config BR2_PACKAGE_TINYCC
        bool "tinycc"
        help
          Tiny CC compiler

	  https://github.com/TinyCC/tinycc/tree/mob
```
